## akhil/akg_nrf52832/akg_nrf52832_defconfig
```kconfig
CONFIG_ARM_MPU=y
CONFIG_HW_STACK_PROTECTION=y

# I2C + logging
CONFIG_I2C=y
CONFIG_LOG=y
CONFIG_LOG_DEFAULT_LEVEL=3
CONFIG_PRINTK=y

# Console (pick one)
CONFIG_USE_SEGGER_RTT=y
CONFIG_RTT_CONSOLE=y
CONFIG_UART_CONSOLE=y

# Bluetooth (Zephyr NUS)
CONFIG_BT=y
CONFIG_BT_PERIPHERAL=y
CONFIG_BT_EXT_ADV=y
CONFIG_BT_MAX_CONN=1
CONFIG_BT_ZEPHYR_NUS=y
CONFIG_BT_DEVICE_NAME="BLE_Alert"
CONFIG_BT_SMP=n

CONFIG_CLOCK_CONTROL_NRF_K32SRC_RC=y
```
